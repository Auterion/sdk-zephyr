## boards/auterion/arfa/Kconfig.arfa
```kconfig
config BOARD_ARFA
	select SOC_NRF5340_CPUAPP_QKAA if BOARD_ARFA_NRF5340_CPUAPP
	select SOC_NRF5340_CPUAPP_QKAA if BOARD_ARFA_NRF5340_CPUAPP_NS
	select SOC_NRF5340_CPUNET_QKAA if BOARD_ARFA_NRF5340_CPUNET
```

## boards/auterion/arfa/board.yml
```yaml
board:
  name: arfa
  vendor: auterion
  socs:
  - name: 'nrf5340'
    variants:
    - name: 'ns'
      cpucluster: 'cpuapp'
```
